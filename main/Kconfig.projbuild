## main/Kconfig.projbuild
```kconfig
menu "GITTA Tschenggins Laempli Configuration"

config FF_NAME
    string "name for prefixing logging output, nvs section, etc."
    default "gitta"
    help
        A short string that is used to prefix any logging output, naming the NVS section, and other things.

config FF_MON_PRIO
    int "system monitor task priority"
    default 9

config FF_CONSOLE_PRIO
    int "console task priority"
    default 8

config FF_WIFI_PRIO
    int "wifi task priority"
    default 7

config FF_LEDS_PRIO
    int "leds task priority"
    default 4

config FF_JENKINS_PRIO
    int "jenkins task priority"
    default 4

config FF_WIFI_RECONNECT_INTERVAL
    int "time [s] to wait before reconnecting"
    default 10

config FF_WIFI_RECONNECT_INTERVAL_SLOW
    int "time [s] to wait before reconnecting after immediate failure"
    default 300

config FF_WIFI_STABLE_CONN_THRS
    int "time [s] after which to consider the connection stable"
    default 300

config FF_BACKEND_URL_MAXLEN
    int "maximum length of backend URL"
    default 500

config FF_ENV_MONITOR_DEFAULT
    string "system monitor period in [s]"
    default "60.0"

config FF_ENV_DEBUG_DEFAULT
    string "debugging output on or off"
    default "off"

config FF_ENV_SSID_DEFAULT
    string "default SSID"
    default ""

config FF_ENV_PASS_DEFAULT
    string "default password"
    default ""

config FF_ENV_BACKEND_DEFAULT
    string "default backend url"
    default ""

config FF_STATUS_LED_GPIO
    int "GPIO for the status LED"
    default 26
    help
        On the Arduino MKR1010 there are LEDs on the following NINA-W102 GPIOs: 26 = RED, 25 = GREEN, 27 = BLUE.
        On the Wemos Mini32 (and many others) the LED is on GPIO 2.

config FF_STATUS_EFFECT_GPIO
    int "GPIO for triggering effect (Chewbacca)"
    default 25

config FF_STATUS_EFFECT_DURATION
    int "effect duration [100ms]"
    default 25

config FF_TONE_GPIO
    int "GPIO for the speaker"
    default 27

config FF_LEDS_MOSI_GPIO
    int "GPIO for MOSI for the LEDs (DI)"
    default 19

config FF_LEDS_SCK_GPIO
    int "GPIO for SCK for the LEDs (CI)"
    default 18

config FF_JENKINS_MAX_CH
    int "maximum number of channels (jobs) we can track"
    default 20

config FF_LEDS_NUM
    int "number of LEDs"
    default 20

config FF_LEDS_SPI_SPEED
    int "SPI speed [Hz]"
    default 2000000
    help
        Must be fast enough for all data to go through in less than 10ms.

endmenu
```

## sdkconfig.defaults
```kconfig
# Arduino MKR WIFI 1010
# CONFIG_ESPTOOLPY_PORT="/dev/ttyACM0"

# ESP32MiniKit Wemos
CONFIG_ESPTOOLPY_PORT="/dev/ttyUSB0"

#CONFIG_ESPTOOLPY_BAUD_115200B=
CONFIG_ESPTOOLPY_BAUD_921600B=y
#CONFIG_ESPTOOLPY_BAUD=921600

# custom partition table
##CONFIG_PARTITION_TABLE_SINGLE_APP=
#CONFIG_PARTITION_TABLE_CUSTOM=y
#CONFIG_PARTITION_TABLE_FILENAME="partitions.csv"

CONFIG_PARTITION_TABLE_SINGLE_APP=y

# monitor and console (stdio)
CONFIG_MONITOR_BAUD=115200
CONFIG_CONSOLE_UART_DEFAULT=y
CONFIG_CONSOLE_UART_BAUDRATE=115200

# enable JTAG debugging
CONFIG_ESP32_DEBUG_OCDAWARE=y
CONFIG_ESP32_DEBUG_STUBS_ENABLE=y


# system stuff
#CONFIG_STACK_CHECK=y
#CONFIG_STACK_CHECK_NONE=
CONFIG_STACK_CHECK_NORM=y
CONFIG_FREERTOS_HZ=1000
CONFIG_SUPPORT_STATIC_ALLOCATION=y
#CONFIG_ENABLE_STATIC_TASK_CLEAN_UP_HOOK=
CONFIG_FREERTOS_USE_TRACE_FACILITY=y
CONFIG_FREERTOS_USE_STATS_FORMATTING_FUNCTIONS=y
CONFIG_FREERTOS_VTASKLIST_INCLUDE_COREID=y
CONFIG_FREERTOS_GENERATE_RUN_TIME_STATS=y
CONFIG_FREERTOS_RUN_TIME_STATS_USING_ESP_TIMER=y
#CONFIG_FREERTOS_RUN_TIME_STATS_USING_CPU_CLK=
CONFIG_MAIN_TASK_STACK_SIZE=8192

CONFIG_ESP32_DEFAULT_CPU_FREQ_80=y
CONFIG_ESP32_DEFAULT_CPU_FREQ_MHZ=80

CONFIG_LOG_DEFAULT_LEVEL_DEBUG=y
CONFIG_LOG_DEFAULT_LEVEL=4
#CONFIG_LOG_DEFAULT_LEVEL_INFO=y
#CONFIG_LOG_DEFAULT_LEVEL=3
#CONFIG_LOG_DEFAULT_LEVEL_WARN=y
#CONFIG_LOG_DEFAULT_LEVEL=2

CONFIG_SYSTEM_EVENT_TASK_STACK_SIZE=4096

CONFIG_TCPIP_TASK_STACK_SIZE=4096
#CONFIG_TCPIP_TASK_AFFINITY_NO_AFFINITY=
CONFIG_TCPIP_TASK_AFFINITY_CPU0=y
CONFIG_TCPIP_TASK_AFFINITY=0x0

# smaller binary size (but breaks GDB)
#CONFIG_OPTIMIZATION_LEVEL_RELEASE=y
#CONFIG_OPTIMIZATION_ASSERTIONS_SILENT=y


# eof
```
